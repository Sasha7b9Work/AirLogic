#if 1
extern "C" {
#include "stm32yyxx_ll_pwr.h"
#include "stm32yyxx_ll_rcc.h"
#include "stm32yyxx_ll_system.h"
#include "stm32yyxx_ll_utils.h"

void SystemClock_Config(void) {
  LL_FLASH_SetLatency(LL_FLASH_LATENCY_5);

  if (LL_FLASH_GetLatency() != LL_FLASH_LATENCY_5) {
    Error_Handler();
  }
  LL_PWR_SetRegulVoltageScaling(LL_PWR_REGU_VOLTAGE_SCALE1);
  LL_RCC_HSE_Enable();

  /* Wait till HSE is ready */
  while (LL_RCC_HSE_IsReady() != 1) {
  }
  LL_PWR_EnableBkUpAccess();
  LL_RCC_ForceBackupDomainReset();
  LL_RCC_ReleaseBackupDomainReset();
  LL_RCC_LSE_Enable();

  /* Wait till LSE is ready */
  while (LL_RCC_LSE_IsReady() != 1) {
  }
  LL_RCC_SetRTCClockSource(LL_RCC_RTC_CLKSOURCE_LSE);
  LL_RCC_EnableRTC();
  LL_RCC_HSE_EnableCSS();
  LL_RCC_PLL_ConfigDomain_SYS(LL_RCC_PLLSOURCE_HSE, LL_RCC_PLLM_DIV_8, 336,
                              LL_RCC_PLLP_DIV_2);
  LL_RCC_PLL_ConfigDomain_48M(LL_RCC_PLLSOURCE_HSE, LL_RCC_PLLM_DIV_8, 336,
                              LL_RCC_PLLQ_DIV_7);
  LL_RCC_PLL_Enable();

  /* Wait till PLL is ready */
  while (LL_RCC_PLL_IsReady() != 1) {
  }
  LL_RCC_SetAHBPrescaler(LL_RCC_SYSCLK_DIV_1);
  LL_RCC_SetAPB1Prescaler(LL_RCC_APB1_DIV_4);
  LL_RCC_SetAPB2Prescaler(LL_RCC_APB2_DIV_2);
  LL_RCC_SetSysClkSource(LL_RCC_SYS_CLKSOURCE_PLL);

  /* Wait till System clock is ready */
  while (LL_RCC_GetSysClkSource() != LL_RCC_SYS_CLKSOURCE_STATUS_PLL) {
  }
  LL_SetSystemCoreClock(168000000);

  /* Update the time base */
  if (HAL_InitTick(TICK_INT_PRIORITY) != HAL_OK) {
    Error_Handler();
  };
#ifdef STM32_FREERTOS_USE_CCM_HEAP
  extern char _sccmram, _eccmram;      // defined by linker script
  __HAL_RCC_CCMDATARAMEN_CLK_ENABLE(); // enable CCM clock after reset (seems
                                       // like DFU loader bug)
  memset(&_sccmram, 0, &_eccmram - &_sccmram); // fill CCM section by zeroes
#endif
}
}
#endif

#ifdef HAL_ADC_MODULE_ENABLED
const PinMap PinMap_ADC[] = {
    {PA_0, ADC3,
     STM_PIN_DATA_EXT(STM_MODE_ANALOG, GPIO_NOPULL, 0, 0,
                      0)}, // ADC3_IN0
                           //    {PA_1, ADC3,
                           //     STM_PIN_DATA_EXT(STM_MODE_ANALOG, GPIO_NOPULL,
                           //     0, 1, 0)}, // ADC3_IN1
    {PA_2, ADC3,
     STM_PIN_DATA_EXT(STM_MODE_ANALOG, GPIO_NOPULL, 0, 2, 0)}, // ADC3_IN2
    {PA_3, ADC3,
     STM_PIN_DATA_EXT(STM_MODE_ANALOG, GPIO_NOPULL, 0, 3, 0)}, // ADC3_IN3
    {PA_4, ADC2,
     STM_PIN_DATA_EXT(STM_MODE_ANALOG, GPIO_NOPULL, 0, 4, 0)}, // ADC2_IN4
    {PA_5, ADC1,
     STM_PIN_DATA_EXT(STM_MODE_ANALOG, GPIO_NOPULL, 0, 5, 0)}, // ADC1_IN5
    {PB_0, ADC2,
     STM_PIN_DATA_EXT(STM_MODE_ANALOG, GPIO_NOPULL, 0, 8, 0)}, // ADC2_IN8
    {PB_1, ADC1,
     STM_PIN_DATA_EXT(STM_MODE_ANALOG, GPIO_NOPULL, 0, 9, 0)}, // ADC1_IN9
    {PC_0, ADC3,
     STM_PIN_DATA_EXT(STM_MODE_ANALOG, GPIO_NOPULL, 0, 10, 0)}, // ADC3_IN10
    {PC_1, ADC3,
     STM_PIN_DATA_EXT(STM_MODE_ANALOG, GPIO_NOPULL, 0, 11, 0)}, // ADC3_IN11
    {PC_2, ADC3,
     STM_PIN_DATA_EXT(STM_MODE_ANALOG, GPIO_NOPULL, 0, 12, 0)}, // ADC3_IN12
    {PC_3, ADC1,
     STM_PIN_DATA_EXT(STM_MODE_ANALOG, GPIO_NOPULL, 0, 13, 0)}, // ADC1_IN13
    {PC_4, ADC1,
     STM_PIN_DATA_EXT(STM_MODE_ANALOG, GPIO_NOPULL, 0, 14, 0)}, // ADC1_IN14
    {PC_5, ADC2,
     STM_PIN_DATA_EXT(STM_MODE_ANALOG, GPIO_NOPULL, 0, 15, 0)}, // ADC2_IN15
    {NC, NP, 0}};
#endif

#ifdef HAL_UART_MODULE_ENABLED
const PinMap PinMap_UART_TX[] = {
    //{PA_0, UART4, STM_PIN_DATA(STM_MODE_AF_PP, GPIO_PULLUP, GPIO_AF8_UART4)},
    {PA_2, USART2, STM_PIN_DATA(STM_MODE_AF_PP, GPIO_PULLUP, GPIO_AF7_USART2)},
    {PA_9, USART1, STM_PIN_DATA(STM_MODE_AF_PP, GPIO_PULLUP, GPIO_AF7_USART1)},
    //    {PB_6, USART1, STM_PIN_DATA(STM_MODE_AF_PP, GPIO_PULLUP,
    //    GPIO_AF7_USART1)},
    //    {PB_10, USART3, STM_PIN_DATA(STM_MODE_AF_PP, GPIO_PULLUP,
    //    GPIO_AF7_USART3)},
    //    {PC_6, USART6, STM_PIN_DATA(STM_MODE_AF_PP, GPIO_PULLUP,
    //    GPIO_AF8_USART6)},
    {PC_10, UART4, STM_PIN_DATA(STM_MODE_AF_PP, GPIO_PULLUP, GPIO_AF8_UART4)},
    //    {PC_10, USART3, STM_PIN_DATA(STM_MODE_AF_PP, GPIO_PULLUP,
    //    GPIO_AF7_USART3)},
    {PC_12, UART5, STM_PIN_DATA(STM_MODE_AF_PP, GPIO_PULLUP, GPIO_AF8_UART5)},
    //    {PD_5, USART2, STM_PIN_DATA(STM_MODE_AF_PP, GPIO_PULLUP,
    //    GPIO_AF7_USART2)},
    {PD_8, USART3, STM_PIN_DATA(STM_MODE_AF_PP, GPIO_PULLUP, GPIO_AF7_USART3)},
    {NC, NP, 0}};
#endif

#ifdef HAL_UART_MODULE_ENABLED
const PinMap PinMap_UART_RX[] = {
    //    {PA_1, UART4, STM_PIN_DATA(STM_MODE_AF_PP, GPIO_PULLUP,
    //    GPIO_AF8_UART4)},
    {PA_3, USART2, STM_PIN_DATA(STM_MODE_AF_PP, GPIO_PULLUP, GPIO_AF7_USART2)},
    {PA_10, USART1, STM_PIN_DATA(STM_MODE_AF_PP, GPIO_PULLUP, GPIO_AF7_USART1)},
    //    {PB_7, USART1, STM_PIN_DATA(STM_MODE_AF_PP, GPIO_PULLUP,
    //    GPIO_AF7_USART1)},
    //    {PB_11, USART3, STM_PIN_DATA(STM_MODE_AF_PP, GPIO_PULLUP,
    //    GPIO_AF7_USART3)},
    //    {PC_7, USART6, STM_PIN_DATA(STM_MODE_AF_PP, GPIO_PULLUP,
    //    GPIO_AF8_USART6)},
    {PC_11, UART4, STM_PIN_DATA(STM_MODE_AF_PP, GPIO_PULLUP, GPIO_AF8_UART4)},
    //    {PC_11, USART3, STM_PIN_DATA(STM_MODE_AF_PP, GPIO_PULLUP,
    //    GPIO_AF7_USART3)},
    {PD_2, UART5, STM_PIN_DATA(STM_MODE_AF_PP, GPIO_PULLUP, GPIO_AF8_UART5)},
    //    {PD_6, USART2, STM_PIN_DATA(STM_MODE_AF_PP, GPIO_PULLUP,
    //    GPIO_AF7_USART2)},
    {PD_9, USART3, STM_PIN_DATA(STM_MODE_AF_PP, GPIO_PULLUP, GPIO_AF7_USART3)},
    {NC, NP, 0}};
#endif

#ifdef HAL_UART_MODULE_ENABLED
const PinMap PinMap_UART_RTS[] = {
    {PA_1, USART2, STM_PIN_DATA(STM_MODE_AF_PP, GPIO_PULLUP, GPIO_AF7_USART2)},
    //    {PA_12, USART1, STM_PIN_DATA(STM_MODE_AF_PP, GPIO_PULLUP,
    //    GPIO_AF7_USART1)}, {PB_14, USART3, STM_PIN_DATA(STM_MODE_AF_PP,
    //    GPIO_PULLUP, GPIO_AF7_USART3)}, {PD_4, USART2,
    //    STM_PIN_DATA(STM_MODE_AF_PP, GPIO_PULLUP, GPIO_AF7_USART2)},
    //{PD_12, USART3, STM_PIN_DATA(STM_MODE_AF_PP, GPIO_PULLUP,
    // GPIO_AF7_USART3)},
    {NC, NP, 0}};
#endif

#ifdef HAL_UART_MODULE_ENABLED
const PinMap PinMap_UART_CTS[] = {
    //    {PA_0, USART2, STM_PIN_DATA(STM_MODE_AF_PP, GPIO_PULLUP,
    //    GPIO_AF7_USART2)},
    //    {PA_11, USART1, STM_PIN_DATA(STM_MODE_AF_PP, GPIO_PULLUP,
    //    GPIO_AF7_USART1)},
    //    {PB_13, USART3, STM_PIN_DATA(STM_MODE_AF_PP, GPIO_PULLUP,
    //    GPIO_AF7_USART3)},
    //    {PD_3, USART2, STM_PIN_DATA(STM_MODE_AF_PP, GPIO_PULLUP,
    //    GPIO_AF7_USART2)},
    //    {PD_11, USART3, STM_PIN_DATA(STM_MODE_AF_PP, GPIO_PULLUP,
    //    GPIO_AF7_USART3)},
    {NC, NP, 0}};
#endif

//*** SPI ***

#ifdef HAL_SPI_MODULE_ENABLED
const PinMap PinMap_SPI_MOSI[] = {
    //    {PA_7, SPI1, STM_PIN_DATA(STM_MODE_AF_PP, GPIO_PULLUP,
    //    GPIO_AF5_SPI1)},
    {PB_5, SPI1, STM_PIN_DATA(STM_MODE_AF_PP, GPIO_PULLUP, GPIO_AF5_SPI1)},
    //    {PB_5, SPI3, STM_PIN_DATA(STM_MODE_AF_PP, GPIO_PULLUP,
    //    GPIO_AF6_SPI3)},
    {PB_15, SPI2, STM_PIN_DATA(STM_MODE_AF_PP, GPIO_PULLUP, GPIO_AF5_SPI2)},
    //    {PC_3, SPI2, STM_PIN_DATA(STM_MODE_AF_PP, GPIO_PULLUP,
    //    GPIO_AF5_SPI2)},
    //    {PC_12, SPI3, STM_PIN_DATA(STM_MODE_AF_PP, GPIO_PULLUP,
    //    GPIO_AF6_SPI3)},
    {NC, NP, 0}};

const PinMap PinMap_SPI_MISO[] = {
    //    {PA_6, SPI1, STM_PIN_DATA(STM_MODE_AF_PP, GPIO_PULLUP,
    //    GPIO_AF5_SPI1)},
    {PB_4, SPI1, STM_PIN_DATA(STM_MODE_AF_PP, GPIO_PULLUP, GPIO_AF5_SPI1)},
    //    {PB_4, SPI3, STM_PIN_DATA(STM_MODE_AF_PP, GPIO_PULLUP,
    //    GPIO_AF6_SPI3)},
    {PB_14, SPI2, STM_PIN_DATA(STM_MODE_AF_PP, GPIO_PULLUP, GPIO_AF5_SPI2)},
    //    {PC_2, SPI2, STM_PIN_DATA(STM_MODE_AF_PP, GPIO_PULLUP,
    //    GPIO_AF5_SPI2)},
    //    {PC_11, SPI3, STM_PIN_DATA(STM_MODE_AF_PP, GPIO_PULLUP,
    //    GPIO_AF6_SPI3)},
    {NC, NP, 0}};

const PinMap PinMap_SPI_SCLK[] = {
    //    {PA_5, SPI1, STM_PIN_DATA(STM_MODE_AF_PP, GPIO_PULLUP,
    //    GPIO_AF5_SPI1)},
    {PB_3, SPI1, STM_PIN_DATA(STM_MODE_AF_PP, GPIO_PULLUP, GPIO_AF5_SPI1)},
    //    {PB_3, SPI3, STM_PIN_DATA(STM_MODE_AF_PP, GPIO_PULLUP,
    //    GPIO_AF6_SPI3)},
    //    {PB_10, SPI2, STM_PIN_DATA(STM_MODE_AF_PP, GPIO_PULLUP,
    //    GPIO_AF5_SPI2)},
    {PB_13, SPI2, STM_PIN_DATA(STM_MODE_AF_PP, GPIO_PULLUP, GPIO_AF5_SPI2)},
    //    {PC_10, SPI3, STM_PIN_DATA(STM_MODE_AF_PP, GPIO_PULLUP,
    //    GPIO_AF6_SPI3)},
    {NC, NP, 0}};

const PinMap PinMap_SPI_SSEL[] = {
    //  {PA_4, SPI1, STM_PIN_DATA(STM_MODE_AF_PP, GPIO_PULLUP, GPIO_AF5_SPI1)},
    //  {PA_4,  SPI3, STM_PIN_DATA(STM_MODE_AF_PP, GPIO_PULLUP, GPIO_AF6_SPI3)},
    {PA_15, SPI1, STM_PIN_DATA(STM_MODE_AF_PP, GPIO_PULLUP, GPIO_AF5_SPI1)},
    //    {PA_15, SPI3, STM_PIN_DATA(STM_MODE_AF_PP, GPIO_PULLUP,
    //    GPIO_AF6_SPI3)},
    //    {PB_9, SPI2, STM_PIN_DATA(STM_MODE_AF_PP, GPIO_PULLUP,
    //    GPIO_AF5_SPI2)},
    {PB_12, SPI2, STM_PIN_DATA(STM_MODE_AF_PP, GPIO_PULLUP, GPIO_AF5_SPI2)},
    {NC, NP, 0}};
#endif

#ifdef HAL_CAN_MODULE_ENABLED
const PinMap PinMap_CAN_RD[] = {
    {PD_0, CAN1, STM_PIN_DATA(STM_MODE_AF_PP, GPIO_NOPULL, GPIO_AF9_CAN1)},
    {NC, NP, 0}};

const PinMap PinMap_CAN_TD[] = {
    {PD_1, CAN1, STM_PIN_DATA(STM_MODE_AF_PP, GPIO_NOPULL, GPIO_AF9_CAN1)},
    {NC, NP, 0}};
#endif

#ifdef STM32_FREERTOS_USE_CCM_HEAP
#include <STM32FreeRTOS.h>
uint8_t ucHeap[STM32_FREERTOS_CCM_HEAP_SIZE]
    __attribute__((section(".ccmram")));
#endif